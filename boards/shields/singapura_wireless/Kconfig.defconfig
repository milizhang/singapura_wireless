## boards/shields/singapura_wireless/Kconfig.defconfig
```kconfig
if SHIELD_SINGAPURA_WIRELESS

config ZMK_KEYBOARD_NAME
    default "Singapura W"

endif # SHIELD_SINGAPURA_WIRELESS
```

## boards/shields/singapura_wireless/Kconfig.shield
```kconfig
config SHIELD_SINGAPURA_WIRELESS
    def_bool $(shields_list_contains,singapura_wireless)
```
